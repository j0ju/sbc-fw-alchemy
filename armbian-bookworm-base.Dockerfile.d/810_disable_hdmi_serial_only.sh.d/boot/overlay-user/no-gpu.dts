/dts-v1/;

/ {
    compatible = "allwinner,sun8i-h3","allwinner,sun50i-h5","friendlyarm,nanopi-neo2";
    fragment@0 {        
        target-path = "/soc";
        __overlay__ {
			gpu@1c40000 {
				status = "disabled";
            };
        };
    };
};

// vim: et ts=4 sw=4 foldmethod=indent
