/dts-v1/;

/ {
    compatible = "allwinner,sun8i-h3","allwinner,sun50i-h5","friendlyarm,nanopi-neo2";
    fragment@0 {        
        target-path = "/soc";
        __overlay__ {
            serial@1c28400 {
            status = "disabled";
            };
        };
    };
};
